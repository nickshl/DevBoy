//******************************************************************************
//  @file Application.cpp
//  @author Nicolai Shlapunov
//
//  @details Application: User Application Class, implementation
//
//  @copyright Copyright (c) 2016, Devtronic & Nicolai Shlapunov
//             All rights reserved.
//
//  @section SUPPORT
//
//   Devtronic invests time and resources providing this open source code,
//   please support Devtronic and open-source hardware/software by
//   donations and/or purchasing products from Devtronic.
//
//******************************************************************************

// *****************************************************************************
// ***   Includes   ************************************************************
// *****************************************************************************
#include "Application.h"

#include "Tetris.h"
#include "Pong.h"
#include "Gario.h"
#include "Calc.h"
#include "GraphDemo.h"
#include "InputTest.h"

#include "fatfs.h"
#include "usbd_cdc.h"

#include "StHalIic.h"
#include "BoschBME280.h"
#include "Mlx90614.h"
#include "Eeprom24.h"
#include "Tcs34725.h"
#include "Vl53l0x.h"

// *****************************************************************************
// ***   Get Instance   ********************************************************
// *****************************************************************************
Application& Application::GetInstance(void)
{
   static Application application;
   return application;
}

// *****************************************************************************
// ***   Test get function   ***************************************************
// *****************************************************************************
char* Application::GetMenuStr(void* ptr, char* buf, uint32_t n, uint32_t add_param)
{
//  Application* app = (Application*)ptr;
  snprintf(buf, n, "%lu", add_param);
  return buf;
}

// *****************************************************************************
// ***   Application Loop   ****************************************************
// *****************************************************************************
Result Application::Loop()
{
  Result result;

  StHalIic iic(hi2c1);

  // Sound control on the touchscreen
  SoundControlBox snd_box(0, 0);
  snd_box.Move(display_drv.GetScreenW() - snd_box.GetWidth(), display_drv.GetScreenH() - snd_box.GetHeight());
  snd_box.Show(32768);

  // ***   Menu Items   ********************************************************
  UiMenu::MenuItem main_menu_items[] =
  {{"Tetris",          nullptr, &Application::GetMenuStr, this, 1},
   {"Pong",            nullptr, &Application::GetMenuStr, this, 2},
   {"Gario",           nullptr, &Application::GetMenuStr, this, 3},
   {"Calc",            nullptr, &Application::GetMenuStr, this, 4},
   {"Graphic demo",    nullptr, &Application::GetMenuStr, this, 5},
   {"Input test",      nullptr, &Application::GetMenuStr, this, 6},
   {"SD write test",   nullptr, &Application::GetMenuStr, this, 7},
   {"USB test",        nullptr, &Application::GetMenuStr, this, 8},
   {"Servo test",      nullptr, &Application::GetMenuStr, this, 9},
   {"Touch calibrate", nullptr, &Application::GetMenuStr, this, 10},
   {"I2C Ping",        nullptr, &Application::GetMenuStr, this, 11}};

  // Create menu object
  UiMenu menu("Main Menu", main_menu_items, NumberOf(main_menu_items));

  // Main cycle
  while(1)
  {
    // Call menu main function
    if(menu.Run())
    {
      switch(menu.GetCurrentPosition())
      {
        // Tetris Application
        case 0:
          Tetris::GetInstance().Loop();
          break;

        // Pong Application
        case 1:
          Pong::GetInstance().Loop();
          break;

        case 2:
          // Gario Application
          Gario::GetInstance().Loop();
          break;

        // Calc Application
        case 3:
          Calc::GetInstance().Loop();
          break;

        // GraphDemo Application
        case 4:
          GraphDemo::GetInstance().Loop();
          break;

        // InputTest Application
        case 5:
          InputTest::GetInstance().Loop();
          break;

        // SD write test
        case 6:
        {
          // Mount SD
          FRESULT fres = f_mount(&SDFatFS, (TCHAR const*)SDPath, 0);
          // Open file
          if(fres == FR_OK)
          {
            fres = f_open(&SDFile, "STM32.TXT", FA_CREATE_ALWAYS | FA_WRITE);
          }
          // Write data to file
          if(fres == FR_OK)
          {
            // File write counts
            UINT wbytes;
            // File write buffer
            char wtext[128];
            snprintf(wtext, NumberOf(wtext), "SD write test. Timestamp: %lu\r\n", HAL_GetTick());
            for(uint32_t i = 0U; i < 10U; i++)
            {
              fres = f_write(&SDFile, wtext, strlen(wtext), &wbytes);
              if(fres != FR_OK) break;
            }
          }
          // Close file
          if(fres == FR_OK)
          {
            fres = f_close(&SDFile);
          }
          // Show result
          if(fres == FR_OK)
          {
            UiMsgBox msg_box("File written successfully", "Success");
            msg_box.Run(3000U);
          }
          else
          {
            UiMsgBox msg_box("File write error", "Error");
            msg_box.Run(3000U);
          }
          break;
        }

        // USB CDC test
        case 7:
        {
          uint8_t str[64];
          // Create string
          snprintf((char*)str, sizeof(str), "USB test. Timestamp: %lu\r\n", HAL_GetTick());
          // Send to USB
          extern USBD_HandleTypeDef hUsbDeviceFS;
          if(USBD_CDC_SetTxBuffer(&hUsbDeviceFS, str, strlen((char*)str)) == USBD_OK)
          {
            USBD_CDC_TransmitPacket(&hUsbDeviceFS);
            // Wait until transmission finished
            while((hUsbDeviceFS.pClassData != nullptr) && (((USBD_CDC_HandleTypeDef*)hUsbDeviceFS.pClassData)->TxState == 1))
            {
              RtosTick::DelayTicks(1U);
            }
          }
          break;
        }

        // Servo test
        case 8:
        {
          // Configure GPIO pin : PB12
          GPIO_InitTypeDef GPIO_InitStruct;
          GPIO_InitStruct.Pin = GPIO_PIN_12;
          GPIO_InitStruct.Mode = GPIO_MODE_OUTPUT_PP;
          GPIO_InitStruct.Pull = GPIO_NOPULL;
          GPIO_InitStruct.Speed = GPIO_SPEED_FREQ_VERY_HIGH;
          HAL_GPIO_Init(GPIOB, &GPIO_InitStruct);

          for(uint32_t n = 0U; n < 100U; n++)
          {
            HAL_GPIO_WritePin(GPIOB, GPIO_PIN_12, GPIO_PIN_SET);
            RtosTick::DelayTicks(1U);
            for(volatile uint32_t i = 0U; i < 1000U; i++);
            HAL_GPIO_WritePin(GPIOB, GPIO_PIN_12, GPIO_PIN_RESET);
            RtosTick::DelayTicks(18U);
          }
        }
        break;

        // Touchscreen Calibration
        case 9:
          display_drv.TouchCalibrate();
          break;

        case 10:
          IicPing(iic);
          break;

        default:
          break;
      }
    }
  }

  // Always run
  return Result::RESULT_OK;
}

// *****************************************************************************
// ***   IicPing   *************************************************************
// *****************************************************************************
Result Application::IicPing(IIic& iic)
{
  // Set error by default for initialize sensor first time
  Result result = Result::ERR_I2C_UNKNOWN;

  // Strings
  String str_arr[2+8+2];
  // Buffer for strings
  static char str_buf[8+2][64] = {0};

  // Header
  str_arr[8].SetParams("  | x0 x1 x2 x3 x4 x5 x6 x7 x8 x9 xA xB xC xD xE xF", 0U, 0, COLOR_WHITE, Font_6x8::GetInstance());
  str_arr[9].SetParams("---------------------------------------------------", 0U, 8, COLOR_WHITE, Font_6x8::GetInstance());
  // Sensor data
  str_arr[10U].SetParams(str_buf[8U], 0U, 8 * (2+10), COLOR_WHITE, Font_8x12::GetInstance());
  str_arr[11U].SetParams(str_buf[9U], 0U, 8 * (2+10) + 12, COLOR_WHITE, Font_8x12::GetInstance());
  // Show strings
  for(uint32_t i = 0U; i < NumberOf(str_arr); i++)
  {
    // Set params for
    if(i < 8U)
    {
      // Set result string
      str_arr[i].SetParams(str_buf[i], 0U, 8 * (2+i), COLOR_WHITE, Font_6x8::GetInstance());
    }
    str_arr[i].Show(10000);
  }

//  // EEPROM test code
//  Eeprom24 eeprom(iic);
//  result = eeprom.Init();
//  uint8_t buf_out[] = "Test!!!";
//  result |= eeprom.Write(0U, buf_out, sizeof(buf_out));
//  uint8_t buf_in[16] = {0};
//  result |= eeprom.Read(0U, buf_in, sizeof(buf_in));
//  RtosTick::DelayMs(1U);

  // Sensor object
  BoschBME280 bmp280(iic);
  Mlx90614 mlx90614(iic);
  Tcs34725 tcs34725(iic);
  Vl53l0x vl53l0x(iic);
  // Set error by default for initialize sensor first time
  result = Result::ERR_I2C_UNKNOWN;

  // Loop until user press "Left"
  while(input_drv.GetButtonState(InputDrv::EXT_LEFT, InputDrv::BTN_LEFT) == false)
  {
    // Ping all I2C adresses
    for(uint32_t i = 0U; i < 8U; i++)
    {
      // Entry
      sprintf(str_buf[i], "%Xx|", (unsigned int)i);
      // Set pointer to empty space
      char* str_ptr = str_buf[i] + 3U;
      // 16 addresses ping
      for(uint32_t j = 0U; j < 16U; j++)
      {
        // Ping device
        Result res = iic.IsDeviceReady((i << 4) | j, 3);
        // Check result
        if(res == Result::RESULT_OK)
        {
          sprintf(str_ptr, " %02X", (unsigned int)((i << 4) | j)); // Received an ACK at that address
        }
        else
        {
          sprintf(str_ptr, " --"); // No ACK received at that address
        }
        str_ptr += 3U;
      }
    }

    // Wait 50 ms - delay for Logic Analyzer
    RtosTick::DelayMs(50U);

    // *************************************************************************
    // ***   BME280   **********************************************************
    // *************************************************************************

//    // Reinitialize sensor
//    if(result.IsBad())
//    {
//      result = bmp280.Initialize();
//      result |= bmp280.SetSampling(BoschBME280::MODE_FORCED);
//    }
//    // Take measurement
//    result |= bmp280.TakeMeasurement();
//    // Get values
//    int32_t temp = bmp280.GetTemperature_x100();
//    int32_t press = bmp280.GetPressure_x256() / 256;
//    int32_t humid = (bmp280.GetHumidity_x1024() * 100) / 1024;
//    // Generate string
//    sprintf(str_buf[8U], "T=%ld.%02ldC P=%ldPa H=%ld.%02ld%% %s", temp/100, abs(temp%100), press, humid/100, abs(humid%100), result.IsGood() ? "" : "ERROR"); // Received an ACK at that address

    // *************************************************************************
    // ***   MLX90614   ********************************************************
    // *************************************************************************

//    // Reinitialize sensor
//    if(result.IsBad())
//    {
//      result = mlx90614.Initialize();
//    }
//
//    if(result.IsGood())
//    {
//      int32_t temp_a = 0;
//      int32_t temp_o1 = 0;
//      int32_t temp_o2 = 0;
//      result =  mlx90614.GetAmbientTemperature_x100(temp_a);
//      result |= mlx90614.GetObjectTemperature_x100(temp_o1);
//      result |= mlx90614.GetObjectTemperature_x100(temp_o2);
//      sprintf(str_buf[8U], "TA=%ld.%02ldC, TO1=%ld.%02ldC, TO2=%ld.%02ldC",
//              temp_a/100, abs(temp_a%100),
//              temp_o1/100, abs(temp_o1%100),
//              temp_o2/100, abs(temp_o2%100));
//    }
//    else
//    {
//      sprintf(str_buf[8U], "ERROR");
//    }

    // *************************************************************************
    // ***   TCS34725   ********************************************************
    // *************************************************************************

//    // Reinitialize sensor
//    if(result.IsBad())
//    {
//      result = tcs34725.Initialize();
//    }
//
//    if(result.IsGood())
//    {
//      bool is_ready = false;
//      // Check data ready
//      result = tcs34725.IsDataReady(is_ready);
//      // If ready
//      if(result.IsGood() && is_ready)
//      {
//        uint16_t r, g, b, c;
//        result = tcs34725.GetRawData(r, g, b, c);
//        if(result.IsGood())
//        {
//          uint16_t lux;
//          uint16_t ct;
//          tcs34725.GetLux(lux);
//          tcs34725.GetColorTemperature(ct);
//          sprintf(str_buf[8U], "R=%5u, G=%5u, B=%5u, C=%5u", r, g, b, c);
//          sprintf(str_buf[9U], "L=%5u, CT=%5u", lux, ct);
//          // Check for low gain
//          if((uint32_t)c * tcs34725.GetGainValue() < 0xFFFFU)
//          {
//            result = tcs34725.IncGain();
//          }
//          // Check for max value
//          if(c == 0xFFFFU)
//          {
//            result = tcs34725.DecGain();
//          }
//        }
//        else
//        {
//          sprintf(str_buf[8U], "ERROR");
//        }
//      }
//    }

    // *************************************************************************
    // ***   VL53L0X   *********************************************************
    // *************************************************************************

    // Reinitialize sensor
    if(result.IsBad())
    {
      result = vl53l0x.Initialize();
    }

    if(result.IsGood())
    {
      uint16_t distance = 0U;
      result = vl53l0x.GetDistanceMm(distance);
      sprintf(str_buf[8U], "Distance: %ld.%03ld m(RAW: %u)", (int32_t)(distance/1000), (int32_t)abs(distance%1000), distance);
    }
    else
    {
      sprintf(str_buf[8U], "ERROR");
    }

    // *************************************************************************
    // ***   IicPing   *********************************************************
    // *************************************************************************

    // Update display
    display_drv.UpdateDisplay();
    // Wait
    RtosTick::DelayMs(100U);
  }

  // Always Ok
  return Result::RESULT_OK;
}

// *****************************************************************************
// *****************************************************************************
// ***   SoundControlBox   *****************************************************
// *****************************************************************************
// *****************************************************************************

const uint8_t mute_off_img[] = {
0xD7, 0xD7, 0xFB, 0xFB, 0xFB, 0xFB, 0xFB, 0xFB, 0xFB, 0xFB, 0xFB, 0xFB, 0xFB, 0xFB, 0xFB, 0xFB, 
0xFB, 0xFB, 0xFB, 0xFB, 0xFB, 0xFB, 0xFB, 0xFB, 0xFB, 0xFB, 0xD7, 0xD7, 0xD7, 0xFB, 0xFB, 0x00, 
0x00, 0x00, 0x00, 0x00, 0x00, 0x00, 0x00, 0x00, 0x00, 0x00, 0x00, 0x00, 0x00, 0x00, 0x00, 0x00, 
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0xFB, 0xFB, 0xFB, 0xFB, 0xFB, 0xFB, 0xFB, 0xFB, 0xFB, 0xFB, 0xFB, 0xFB, 0xFB, 0xFB, 0xD7, 0xD7};

const uint8_t mute_on_img[] = {
0xD7, 0xD7, 0xFB, 0xFB, 0xFB, 0xFB, 0xFB, 0xFB, 0xFB, 0xFB, 0xFB, 0xFB, 0xFB, 0xFB, 0xFB, 0xFB, 
0xFB, 0xFB, 0xFB, 0xFB, 0xFB, 0xFB, 0xFB, 0xFB, 0xFB, 0xFB, 0xD7, 0xD7, 0xD7, 0xFB, 0xFB, 0x00, 
0x00, 0x00, 0x00, 0x00, 0x00, 0x00, 0x00, 0x00, 0x00, 0x00, 0x00, 0x00, 0x00, 0x00, 0x00, 0x00, 
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0xFB, 0xFB, 0xFB, 0xFB, 0xFB, 0xFB, 0xFB, 0xFB, 0xFB, 0xFB, 0xFB, 0xFB, 0xFB, 0xFB, 0xD7, 0xD7};

const ImageDesc mute_img[] = {
{28, 28, 8, {.img = mute_off_img}, PALETTE_676, PALETTE_676[0xD7]},
{28, 28, 8, {.img = mute_on_img},  PALETTE_676, PALETTE_676[0xD7]}};

// *****************************************************************************
// ***   Constructor   *********************************************************
// *****************************************************************************
SoundControlBox::SoundControlBox(int32_t x, int32_t y, bool mute_flag) :
                                                        Image(x, y, mute_img[0])
{
  // Store mute flag
  mute = mute_flag;
  // If mute is false - update image
  if(mute == false)
  {
    SetImage(mute_img[0]);
  }
  sound_drv.Mute(mute);
  // This object is active
  active = true;
}

// *****************************************************************************
// ***   Action   **************************************************************
// *****************************************************************************
void SoundControlBox::Action(ActionType action, int32_t tx, int32_t ty, int32_t tpx, int32_t tpy)
{
  // Switch for process action
  switch(action)
  {
    // Touch action
    case VisObject::ACT_TOUCH:
      // Change checked state
      mute = !mute;
      // Update image
      if(mute == true)
      {
        SetImage(mute_img[0], true); // Don't take semaphore - already taken
      }
      else
      {
        SetImage(mute_img[1], true); // Don't take semaphore - already taken
      }
      // Mute control
      sound_drv.Mute(mute);
      break;

    // Untouch action 
    case VisObject::ACT_UNTOUCH:
      break;

    default:
      break;
  }
}
